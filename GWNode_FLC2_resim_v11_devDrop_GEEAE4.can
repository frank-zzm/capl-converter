/*@!Encoding:1252*/
includes
{
  
 // #include "test\fileToConvert.cin"
  #include "fileToConvert.cin" // Defines variable "fileToConvert"
}

variables
{
  const dword cFrNullFlag = 0x400; // only for VN
  
  msTimer replayCheck;
  char fileName[500], filePath[1000], relFilePath[500];
  dword fileHandler;
  byte loggerStarted = 0;
  int64 lastTimeStamp = 0;
  int64 firstTimeStamp = -1;
  int has_logged_timesyn=0;
  
  byte synchInfoReceived = 0;
  byte synchLog = 0;
  
 // frFrame TargetNetwork::ASDMFlcFlexTimeSynchFr targetTimeSynchFr;
  
  byte receivedAsdmFLC_FlexraySignalIPdu00 = 0;
  byte receivedAsdmFLC_FlexraySignalIPdu01 = 0;
  byte receivedAsdmFLC_FlexraySignalIPdu02 = 0;
  byte receivedAsdmFLC_FlexraySignalIPdu03 = 0;
  byte receivedAsdmFLC_FlexraySignalIPdu04 = 0;
  byte receivedAsdmFLC_FlexraySignalIPdu05 = 0;
  byte receivedAsdmFLC_FlexraySignalIPdu06 = 0;
  byte receivedAsdmFLC_FlexraySignalIPdu07 = 0;
  byte receivedAsdmFlcFRNmPdu1 = 0;
  byte receivedASDMFlcFlexTimeSynchPdu = 0;
  byte receivedAsdmPrototypeMid2FlxSignalIPDU01 = 0;
  
  
  byte hardcodedParameters = 0;

  const byte CRC8_H2F_START_VALUE = 0xff;
  const byte CRC8_START_VALUE     = 0xff;
  const byte CRC8_POLYNOMIAL      = 0x2f;
  const byte CRC8_H2F_POLYNOMIAL  = 0x2f;
  const byte CRC8_XOR             = 0xff;
  const byte CRC8_H2F_XOR         = 0xff;
  
  byte dataIDlist[16] = {0, 1, 2, 3, 4, 5, 6, 7, 8, 9, 10, 11, 12, 13, 14, 15};
  byte testVector[14] = {1, 2, 3, 4, 5, 6, 7, 8, 9, 10, 11, 12, 13, 14};
  
  int64  temp_isAgDataRawSafeYawRate;
  int  temp_isAgDataRawSafeRollRateQf ;
  int  temp_isAgDataRawSafeYawRateQf;
  int  temp_isAgDataRawSafeChks ;
  int temp_isAgDataRawSafeCntr ;
  int64  temp_isAgDataRawSafeRollRate;
  int  temp_isADataRawSafeAVertQf;
  int64  temp_isADataRawSafeALgt;
  int  temp_isADataRawSafeALat;
  int  temp_isADataRawSafeChks;
  int  temp_isADataRawSafeALat1Qf;
  int  temp_isADataRawSafeCntr;
  int  temp_isADataRawSafeALgt1Qf;
  int64  temp_isADataRawSafeAVert;
  
  
  
}

on start
{
 
  setReplayFileName("ReplayBlock 1",fileToConvert,"asc");
  //setReplayFilename ("ReplayBlock 2",fileCAN,"asc");

  //snprintf(filePath,elcount(filePath),"\\conversionFolder\\_tmpConv_%s",fileName);
  write("file path log: %s", loggingFile);      
  setLogFileName("Logging", loggingFile);

  lastTimeStamp = 0;
  replayStart("ReplayBlock 1");
 // replayStart ("ReplayBlock 2");

  setTimer(replayCheck, 2000);
  write("start time is %f",timeNow()/100000.0);
 // startLogging("logging");
  
  
}

on preStop
{
  writeToLog("Last time stamp: %I64d\n", lastTimeStamp);
  
  StopLogging ("Logging");
  loggerStarted = 0;
  write("end time is %f",timeNow()/100000.0 );
}

on timer replayCheck
{
  if(ReplayState("ReplayBlock 1")!=1)
  {
    writeToLog("Last time stamp: %I64d\n", lastTimeStamp);

    StopLogging ("Logging");
    loggerStarted = 0;
    stop();

//    receivedAsdmFLC_FlexraySignalIPdu00 = 0;
//    receivedAsdmFLC_FlexraySignalIPdu01 = 0;
//    receivedAsdmFLC_FlexraySignalIPdu02 = 0;
//    receivedAsdmFLC_FlexraySignalIPdu03 = 0;
//    receivedAsdmMid2FlxSignalIPDU06 = 0;
//    receivedAsdmFlcFRNmPdu1 = 0;
//    receivedASDMFlcFlexTimeSynchPdu = 0;
//    receivedAsdmPrototypeMid2FlxSignalIPDU01 = 0;
//
//    if(fileGetString (fileName, elcount(fileName), fileHandler)!= 0)
//    {
//      fileName[strlen(fileName)-1]=0;
//      write("File read: %s",fileName);
//      
//      snprintf(relFilePath,elcount(relFilePath),"\\conversionFolder\\%s",fileName);
//      getAbsFilePath(relFilePath, filePath, elcount(filePath));
//      write("file path reply: %s",filePath);
//      setReplayFileName("ReplayBlock 1",filePath,"asc");
//      
//      lastTimeStamp = 0;
//      replayStart("ReplayBlock 1");
//      
//      snprintf(filePath,elcount(filePath),"\\conversionFolder\\_tmpConv_%s",fileName);
//      write("file path log: %s",filePath);      
//      setLogFileName("Logging",filePath);
//    }
//    else{
//      writeToLog("Last time stamp: %I64d\n", lastTimeStamp);
//
//      StopLogging ("Logging");
//      loggerStarted = 0;
//      stop();
//    }
  }
  else{
   // write("replay Ongoing");
  }

  settimer(replayCheck,200);

}

void checkLogger(int64 currentTimeStamp)
{
    if (firstTimeStamp < 0)
    {
        firstTimeStamp = currentTimeStamp;
    }

    
    if (loggerStarted != 1)
    {
        startLogging("Logging");
        
        //writeToLog("First time stamp: %I64d\n", firstTimeStamp);

        loggerStarted = 1;
    }
    
    if (lastTimeStamp < currentTimeStamp)
    {
        lastTimeStamp = currentTimeStamp;
    }
    
}

//CAN data conversion
//on PDU sourceCAN::BbmAdRedundancySignalIPdu10
//{
//  frPDU TargetNetwork::AsdmFLC_FlexraySignalIPdu00 targetPDU;  
// // targetPDU .isADataRawSafeChks = this.isADataRawSafeChks;
//  write("we can get can data");
//}


  //sourceNetwork::AsdmFLC_FlexraySignalIPdu00 has been done
on frPDU SourceNetwork::AsdmFLC_FlexraySignalIPdu00
{
    frPDU TargetNetwork::AsdmFLC_FlexraySignalIPdu00 targetPDU;

    checkLogger(this.Time_ns);
  startLogging("logging");
    if (receivedAsdmFLC_FlexraySignalIPdu00 == 0)
    {
        receivedAsdmFLC_FlexraySignalIPdu00 = 1;
      write("it is send out by pdu00");
    }
  
    //targetPDU.isFRNetworkStatusMid2 = this.isFRNetworkStatusMid2;
	targetPDU.isFRNetworkStatusASDM2FLC = this.isFRNetworkStatusASDM2FLC;
  targetPDU.isAebObjectVisionID = this.isAebObjectVisionID;




   
    // Set update bits
    //targetPDU.igAmbTRaw_UB = this.igAmbTRaw_UB;
  targetPDU.isAebObjectVisionID_UB = this.isAebObjectVisionID_UB;
	
  frUpdatePDU(targetPDU, 1, -1);
}

//sourceNetwork::AsdmFLC_FlexraySignalIPdu01 has been done
on frPDU SourceNetwork::AsdmFLC_FlexraySignalIPdu01
{
    frPDU TargetNetwork::AsdmFLC_FlexraySignalIPdu01 targetPDU;

    checkLogger(this.Time_ns);
    if(receivedAsdmFLC_FlexraySignalIPdu01 == 0)
    {
        receivedAsdmFLC_FlexraySignalIPdu01 = 1;
    }

	//targetPDU.isVehMtnStVehMtnSt = this.isVehMtnStVehMtnSt;
  targetPDU.isADataRawSafeALat = this.isADataRawSafeALat;
  targetPDU.isADataRawSafeALat1Qf = this.isADataRawSafeALat1Qf;
  targetPDU.isADataRawSafeALgt = this.isADataRawSafeALgt;
  targetPDU.isADataRawSafeALgt1Qf = this.isADataRawSafeALgt1Qf;
  targetPDU.isADataRawSafeAVert = this.isADataRawSafeAVert;
  targetPDU.isADataRawSafeAVertQf = this.isADataRawSafeAVertQf;
  targetPDU.isADataRawSafeChks = this.isADataRawSafeChks;
  targetPDU.isADataRawSafeCntr = this.isADataRawSafeCntr;
  targetPDU.isAgDataRawSafeChks = this.isAgDataRawSafeChks;
  targetPDU.isAgDataRawSafeCntr = this.isAgDataRawSafeCntr;
  targetPDU.isAgDataRawSafeRollRate = this.isAgDataRawSafeRollRate;
  targetPDU.isAgDataRawSafeRollRateQf = this.isAgDataRawSafeRollRateQf;
  targetPDU.isAgDataRawSafeYawRate = this.isAgDataRawSafeYawRate;
  targetPDU.isAgDataRawSafeYawRateQf = this.isAgDataRawSafeYawRateQf;
  targetPDU.isAsyDataWithCmpSafeALat1Qf = this.isAsyDataWithCmpSafeALat1Qf;
  targetPDU.isAsyDataWithCmpSafeALatWithCmp = this.isAsyDataWithCmpSafeALatWithCmp;
  targetPDU.isAsyDataWithCmpSafeALgt1Qf = this.isAsyDataWithCmpSafeALgt1Qf;
  targetPDU.isAsyDataWithCmpSafeChks = this.isAsyDataWithCmpSafeChks;
  targetPDU.isAsyDataWithCmpSafeCntr = this.isAsyDataWithCmpSafeCntr;
  targetPDU.isAsyDataWithCmpSafeGrdtOfALgt = this.isAsyDataWithCmpSafeGrdtOfALgt;
  targetPDU.isAsyDataWithCmpSafeYawRateQf = this.isAsyDataWithCmpSafeYawRateQf;
  targetPDU.isAsyDataWithCmpSafeYawRateWithCmp = this.isAsyDataWithCmpSafeYawRateWithCmp;
  targetPDU.isSteerWhlSnsrChks = this.isSteerWhlSnsrChks;
  targetPDU.isSteerWhlSnsrCntr = this.isSteerWhlSnsrCntr;
  targetPDU.isSteerWhlSnsrQf = this.isSteerWhlSnsrQf;
  targetPDU.isSteerWhlSnsrSteerWhlAg = this.isSteerWhlSnsrSteerWhlAg;
  targetPDU.isSteerWhlSnsrSteerWhlAgSpd = this.isSteerWhlSnsrSteerWhlAgSpd;
  targetPDU.isVehMtnStChks = this.isVehMtnStChks;
  targetPDU.isVehMtnStCntr = this.isVehMtnStCntr;
  targetPDU.isVehMtnStVehMtnSt = this.isVehMtnStVehMtnSt;
  targetPDU.isVehSpdLgtChks = this.isVehSpdLgtChks;
  targetPDU.isVehSpdLgtCntr = this.isVehSpdLgtCntr;
  targetPDU.isVehSpdLgtQf = this.isVehSpdLgtQf;
  targetPDU.isVehSpdLgtVehSpdLgt = this.isVehSpdLgtVehSpdLgt;
  targetPDU.isWhlDirRotlReChks = this.isWhlDirRotlReChks;
  targetPDU.isWhlDirRotlReCntr = this.isWhlDirRotlReCntr;
  targetPDU.isWhlDirRotlReLe = this.isWhlDirRotlReLe;
  targetPDU.isWhlDirRotlReRi = this.isWhlDirRotlReRi;
  targetPDU.isWhlSpdCircumlFrntChks = this.isWhlSpdCircumlFrntChks;
  targetPDU.isWhlSpdCircumlFrntCntr = this.isWhlSpdCircumlFrntCntr;
  targetPDU.isWhlSpdCircumlFrntLe = this.isWhlSpdCircumlFrntLe;
  //targetPDU.isWhlSpdCircumlFrntLeQf = this.isWhlSpdCircumlFrntLeQf;
  targetPDU.isWhlSpdCircumlFrntLeQf=3;
  targetPDU.isWhlSpdCircumlFrntRi = this.isWhlSpdCircumlFrntRi;
  targetPDU.isWhlSpdCircumlFrntRiQf = this.isWhlSpdCircumlFrntRiQf;
  targetPDU.isWhlSpdCircumlFrntRiQf = 3;  
  targetPDU.isWhlSpdCircumlReChks = this.isWhlSpdCircumlReChks;
  targetPDU.isWhlSpdCircumlReCntr = this.isWhlSpdCircumlReCntr;
  targetPDU.isWhlSpdCircumlReLe = this.isWhlSpdCircumlReLe;
  targetPDU.isWhlSpdCircumlReLeQf = this.isWhlSpdCircumlReLeQf;
  targetPDU.isWhlSpdCircumlReRi = this.isWhlSpdCircumlReRi;
  targetPDU.isWhlSpdCircumlReRiQf = this.isWhlSpdCircumlReRiQf;


    
    //SET UPDATE BIT
  targetPDU.igADataRawSafe_UB = this.igADataRawSafe_UB;
  targetPDU.igAgDataRawSafe_UB = this.igAgDataRawSafe_UB;
  targetPDU.igAsyDataWithCmpSafe_UB = this.igAsyDataWithCmpSafe_UB;
  targetPDU.igSteerWhlSnsr_UB = this.igSteerWhlSnsr_UB;
  targetPDU.igVehMtnSt_UB = this.igVehMtnSt_UB;
  targetPDU.igVehSpdLgt_UB = this.igVehSpdLgt_UB;
  targetPDU.igWhlDirRotlRe_UB = this.igWhlDirRotlRe_UB;
  targetPDU.igWhlSpdCircumlFrnt_UB = this.igWhlSpdCircumlFrnt_UB;
  targetPDU.igWhlSpdCircumlRe_UB = this.igWhlSpdCircumlRe_UB;
    
    frUpdatePDU(targetPDU, 1, -1);
}
 

//sourceNetwork::AsdmFLC_FlexraySignalIPdu02 has been done
on frPDU SourceNetwork::AsdmFLC_FlexraySignalIPdu02
{
    frPDU TargetNetwork::AsdmFLC_FlexraySignalIPdu02 targetPDU;

    checkLogger(this.Time_ns);
    if (receivedAsdmFLC_FlexraySignalIPdu02 == 0)
    {
        receivedAsdmFLC_FlexraySignalIPdu02 = 1;
    }
  targetPDU.isCamSnsrVehPrmVehLvlFrL = this.isCamSnsrVehPrmVehLvlFrL;
  targetPDU.isCamSnsrVehPrmDstLongToHdLamp = this.isCamSnsrVehPrmDstLongToHdLamp;
  targetPDU.isCamSnsrVehPrmDrWheel = this.isCamSnsrVehPrmDrWheel;
  targetPDU.isCamSnsrVehPrmWhlRadius = this.isCamSnsrVehPrmWhlRadius;
  targetPDU.isCamSnsrVehPrmDstVertToHdLamp = this.isCamSnsrVehPrmDstVertToHdLamp;
  targetPDU.isCamSnsrVehPrmVehHgt = this.isCamSnsrVehPrmVehHgt;
  targetPDU.isCamSnsrVehPrmDynWhlRadRe = this.isCamSnsrVehPrmDynWhlRadRe;
  targetPDU.isCamSnsrVehPrmVehLvlFrR = this.isCamSnsrVehPrmVehLvlFrR;
  targetPDU.isCamSnsrVehPrmVehWidth = this.isCamSnsrVehPrmVehWidth;
  targetPDU.isCamSnsrVehPrmSlipAglGrad = this.isCamSnsrVehPrmSlipAglGrad;
  targetPDU.isCamSnsrVehPrmVehLvlOffset = this.isCamSnsrVehPrmVehLvlOffset;
  targetPDU.isCamSnsrVehPrmAxlLdDtrb = this.isCamSnsrVehPrmAxlLdDtrb;
  targetPDU.isCamSnsrVehPrmDstLatToWhlCentr = this.isCamSnsrVehPrmDstLatToWhlCentr;
  targetPDU.isCamSnsrVehPrmHoodAg = this.isCamSnsrVehPrmHoodAg;
  targetPDU.isCamSnsrVehPrmVehInert = this.isCamSnsrVehPrmVehInert;
  targetPDU.isCamSnsrVehPrmVehWhlBas = this.isCamSnsrVehPrmVehWhlBas;
  targetPDU.isCamSnsrVehPrmCalTgtPosY = this.isCamSnsrVehPrmCalTgtPosY;
  targetPDU.isCamSnsrVehPrmVehFrTrkWidth = this.isCamSnsrVehPrmVehFrTrkWidth;
  targetPDU.isCamSnsrVehPrmAxleHeiRe = this.isCamSnsrVehPrmAxleHeiRe;
  targetPDU.isCamSnsrVehPrmCalTgtPosX = this.isCamSnsrVehPrmCalTgtPosX;
  targetPDU.isCamSnsrVehPrmFrAxHgt = this.isCamSnsrVehPrmFrAxHgt;
  targetPDU.isCamSnsrVehPrmCalTgtPosZ = this.isCamSnsrVehPrmCalTgtPosZ;
  targetPDU.isCamSnsrVehPrmVehReTrkWidth = this.isCamSnsrVehPrmVehReTrkWidth;
  targetPDU.isCamSnsrVehPrmChks = this.isCamSnsrVehPrmChks;
  targetPDU.isCamSnsrVehPrmDstLgtToBmpFrnt = this.isCamSnsrVehPrmDstLgtToBmpFrnt;
  targetPDU.isCamSnsrVehPrmVehLvlReL = this.isCamSnsrVehPrmVehLvlReL;
  targetPDU.isCamSnsrVehPrmDstLatToHdLamp = this.isCamSnsrVehPrmDstLatToHdLamp;
  targetPDU.isCamSnsrVehPrmVehLen = this.isCamSnsrVehPrmVehLen;
  targetPDU.isCamSnsrVehPrmDisFrAxToBump = this.isCamSnsrVehPrmDisFrAxToBump;
  targetPDU.isCamSnsrVehPrmDynWhlRadFr = this.isCamSnsrVehPrmDynWhlRadFr;
  targetPDU.isCamSnsrVehPrmVehWeight = this.isCamSnsrVehPrmVehWeight;
  targetPDU.isCamSnsrVehPrmCntr = this.isCamSnsrVehPrmCntr;
  targetPDU.isCamSnsrVehPrmSelfStrGrad = this.isCamSnsrVehPrmSelfStrGrad;
  targetPDU.isCamSnsrVehPrmPinionAgToWhlAgFac = this.isCamSnsrVehPrmPinionAgToWhlAgFac;
  targetPDU.isCamSnsrVehPrmVehLvlReR = this.isCamSnsrVehPrmVehLvlReR;
  //set update bit
  targetPDU.igCamSnsrVehPrm_UB = this.igCamSnsrVehPrm_UB;
    
  frUpdatePDU(targetPDU, 1, -1);
}

//sourceNetwork::AsdmFLC_FlexraySignalIPdu03 has been done
on frPDU SourceNetwork::AsdmFLC_FlexraySignalIPdu03
{
    frPDU TargetNetwork::AsdmFLC_FlexraySignalIPdu03 targetPDU;

    checkLogger(this.Time_ns);
    if (receivedAsdmFLC_FlexraySignalIPdu03 == 0)
    {
        receivedAsdmFLC_FlexraySignalIPdu03 = 1;
      // write("it is send out by pdu03");
    }
  targetPDU.isAmbTRawAmbTVal = this.isAmbTRawAmbTVal;
  targetPDU.isAmbTRawQly = this.isAmbTRawQly;
  targetPDU.isBkpOfDstTrvld = this.isBkpOfDstTrvld;
  targetPDU.isCamSnsrPoseChks = this.isCamSnsrPoseChks;
  targetPDU.isCamSnsrPoseCntr = this.isCamSnsrPoseCntr;
  targetPDU.isCamSnsrPosePitchAg = this.isCamSnsrPosePitchAg;
  targetPDU.isCamSnsrPosePosnLat = this.isCamSnsrPosePosnLat;
  targetPDU.isCamSnsrPosePosnLgt = this.isCamSnsrPosePosnLgt;
  targetPDU.isCamSnsrPosePosnVert = this.isCamSnsrPosePosnVert;
  targetPDU.isCamSnsrPoseRollAg = this.isCamSnsrPoseRollAg;
  targetPDU.isCamSnsrPoseYawAg = this.isCamSnsrPoseYawAg;
  targetPDU.isCarTiGlb = this.isCarTiGlb;
  targetPDU.isHznDataCountryCode = this.isHznDataCountryCode;
  targetPDU.isHznDataCyclicCounter = this.isHznDataCyclicCounter;
  targetPDU.isHznDataDrivingSide = this.isHznDataDrivingSide;
  targetPDU.isHznDataHardwareVersion = this.isHznDataHardwareVersion;
  targetPDU.isHznDataMajorProtocolVersion = this.isHznDataMajorProtocolVersion;
  targetPDU.isHznDataMapProvider = this.isHznDataMapProvider;
  targetPDU.isHznDataMapVersionYear = this.isHznDataMapVersionYear;
  targetPDU.isHznDataMapVersionYearQuarter = this.isHznDataMapVersionYearQuarter;
  targetPDU.isHznDataMessageType = this.isHznDataMessageType;
  targetPDU.isHznDataMinorProtocolSubVersion = this.isHznDataMinorProtocolSubVersion;
  targetPDU.isHznDataMinorProtocolVersion = this.isHznDataMinorProtocolVersion;
  targetPDU.isHznDataRegionCode = this.isHznDataRegionCode;
  targetPDU.isHznDataSpeedUnits = this.isHznDataSpeedUnits;
  targetPDU.isTrsmActrPosnSafeTrsmActrPosn = this.isTrsmActrPosnSafeTrsmActrPosn;
  targetPDU.isTrsmActrPosnSafeTrsmActrPosnChks = this.isTrsmActrPosnSafeTrsmActrPosnChks;
  targetPDU.isTrsmActrPosnSafeTrsmActrPosnCntr = this.isTrsmActrPosnSafeTrsmActrPosnCntr;
  targetPDU.isVehBattUSysU = this.isVehBattUSysU;
  targetPDU.isVehBattUSysUQf = this.isVehBattUSysUQf;
  targetPDU.isVehModMngtGlbSafe1CarModSts1 = this.isVehModMngtGlbSafe1CarModSts1;
  targetPDU.isVehModMngtGlbSafe1CarModSubtypWdCarModSubtyp = this.isVehModMngtGlbSafe1CarModSubtypWdCarModSubtyp;
  targetPDU.isVehModMngtGlbSafe1Chks = this.isVehModMngtGlbSafe1Chks;
  targetPDU.isVehModMngtGlbSafe1Cntr = this.isVehModMngtGlbSafe1Cntr;
  targetPDU.isVehModMngtGlbSafe1EgyLvlElecMai = this.isVehModMngtGlbSafe1EgyLvlElecMai;
  targetPDU.isVehModMngtGlbSafe1EgyLvlElecSubtyp = this.isVehModMngtGlbSafe1EgyLvlElecSubtyp;
  targetPDU.isVehModMngtGlbSafe1FltEgyCnsWdSts = this.isVehModMngtGlbSafe1FltEgyCnsWdSts;
  targetPDU.isVehModMngtGlbSafe1PwrLvlElecMai = this.isVehModMngtGlbSafe1PwrLvlElecMai;
  targetPDU.isVehModMngtGlbSafe1PwrLvlElecSubtyp = this.isVehModMngtGlbSafe1PwrLvlElecSubtyp;
  targetPDU.isVehModMngtGlbSafe1UsgModSts = this.isVehModMngtGlbSafe1UsgModSts;
  targetPDU.isVehSpdIndcdQly = this.isVehSpdIndcdQly;
  targetPDU.isVehSpdIndcdVehSpdIndcd = this.isVehSpdIndcdVehSpdIndcd;
  targetPDU.isVehSpdIndcdVeSpdIndcdUnit = this.isVehSpdIndcdVeSpdIndcdUnit;
  targetPDU.isVinBlockNr = this.isVinBlockNr;
  targetPDU.isVinVINSignalPos1 = this.isVinVINSignalPos1;
  targetPDU.isVinVINSignalPos2 = this.isVinVINSignalPos2;
  targetPDU.isVinVINSignalPos3 = this.isVinVINSignalPos3;
  targetPDU.isVinVINSignalPos4 = this.isVinVINSignalPos4;
  targetPDU.isVinVINSignalPos5 = this.isVinVINSignalPos5;
  targetPDU.isVinVINSignalPos6 = this.isVinVINSignalPos6;
  targetPDU.isVinVINSignalPos7 = this.isVinVINSignalPos7;
  //SET UPDATE BIT
  targetPDU.igAmbTRaw_UB = this.igAmbTRaw_UB;
  targetPDU.igCamSnsrPose_UB = this.igCamSnsrPose_UB;
  targetPDU.igHznData_UB = this.igHznData_UB;
  targetPDU.igTrsmActrPosnSafe_UB = this.igTrsmActrPosnSafe_UB;
  targetPDU.igVehBattU_UB = this.igVehBattU_UB;
  targetPDU.igVehModMngtGlbSafe1_UB = this.igVehModMngtGlbSafe1_UB;
  targetPDU.igVehSpdIndcd_UB = this.igVehSpdIndcd_UB;
  targetPDU.igVin_UB = this.igVin_UB;
  targetPDU.isBkpOfDstTrvld_UB = this.isBkpOfDstTrvld_UB;
  targetPDU.isCarTiGlb_UB = this.isCarTiGlb_UB;
  targetPDU.isVehSpdIndcdQly_UB = this.isVehSpdIndcdQly_UB;
  //output fr  
  frUpdatePDU(targetPDU, 1, -1);
}



//sourceNetwork::AsdmFlcFRNmPdu1 has been done
on frPDU SourceNetwork::AsdmFlcFRNmPdu1   
{
    frPDU TargetNetwork::AsdmFlcFRNmPdu1 targetPDU;

    checkLogger(this.Time_ns);
    if (receivedAsdmFlcFRNmPdu1 == 0)
    {
        receivedAsdmFlcFRNmPdu1 = 1;
        write("SourceNetwork::AsdmFlcFRNmPdu1");
    }

  //targetPDU.Byte0 = this.fr_Payload[0];
//  targetPDU.fr_Payload[0] = this.fr_Payload[0];
//  targetPDU .Bytes[0] = this.fr_Payload[0];
//  targetPDU.Byte1 = this.fr_Payload[1];
//  targetPDU.Byte2 = this.fr_Payload[2];
//  targetPDU.Byte3 = this.fr_Payload[3];
//  targetPDU.Byte4 = this.fr_Payload[4];
//  targetPDU.Byte5 = this.fr_Payload[5];
//  targetPDU.Byte6 = this.fr_Payload[6];
//  targetPDU.Byte7 = this.fr_Payload[7];
  targetPDU.byte(0)   = this.fr_Payload[0];
  targetPDU.byte(1)   = this.fr_Payload[1];
  targetPDU.byte(2)   = this.fr_Payload[2];
  targetPDU.byte(3)   = this.fr_Payload[3];
  targetPDU.byte(4)   = this.fr_Payload[4];
  targetPDU.byte(5)   = this.fr_Payload[5];
  targetPDU.byte(6)   = this.fr_Payload[6];
  targetPDU.byte(7)   = this.fr_Payload[7];

  frUpdatePDU(targetPDU, 1, -1);

}

//sourceNetwork::ASDMFlcFlexTimeSynchPdu has been done
on frPDU SourceNetwork::ASDMFlcFlexTimeSynchPdu
{
  frPDU TargetNetwork::ASDMFlcFlexTimeSynchPdu targetPDU;

  
  checkLogger(this.Time_ns);
  if (receivedASDMFlcFlexTimeSynchPdu == 0)
  {
      receivedASDMFlcFlexTimeSynchPdu = 1;
  }

  targetPDU.byte(0) = this.fr_Payload[0];
  targetPDU.byte(1) = this.fr_Payload[1];
  targetPDU.byte(2) = this.fr_Payload[2];
  targetPDU.byte(3) = this.fr_Payload[3];
  targetPDU.byte(4) = this.fr_Payload[4];
  targetPDU.byte(5) = this.fr_Payload[5];
  targetPDU.byte(6) = this.fr_Payload[6];
  targetPDU.byte(7) = this.fr_Payload[7];
  targetPDU.byte(8) = this.fr_Payload[8];
  targetPDU.byte(9) = this.fr_Payload[9];
  targetPDU.byte(10) = this.fr_Payload[10];
  targetPDU.byte(11) = this.fr_Payload[11];
  targetPDU.byte(12) = this.fr_Payload[12];
  targetPDU.byte(13) = this.fr_Payload[13];
  targetPDU.byte(14) = this.fr_Payload[14];  
  targetPDU.byte(15) = this.fr_Payload[15];

  frUpdatePDU(targetPDU, 1, -1);
}
void setTimeSynchPdu( )
{
    frPDU TargetNetwork::ASDMFlcFlexTimeSynchPdu targetPDU;
//  long res = 0;
//  byte i = 0;
//  byte n = 0;
//  byte remainder = 0;
//  byte dataValue = 0;
//  byte crc = 0;
//  byte sc = 0;
  
  
   startLogging("Logging");
    if (receivedASDMFlcFlexTimeSynchPdu == 0)
  {
      receivedASDMFlcFlexTimeSynchPdu = 1;
     write("logTimeSynch_first");
  }



  targetPDU.byte(0) = 0;
  targetPDU.byte(1) = 0;
  targetPDU.byte(2) = 0;
  targetPDU.byte(3) = 0;
  targetPDU.byte(4) = 0;
  targetPDU.byte(5) = 0;
  targetPDU.byte(6) = 0;
  targetPDU.byte(7) = 0;
  targetPDU.byte(8) = 0;
  targetPDU.byte(9) = 0;
  targetPDU.byte(10) =0;
  targetPDU.byte(11) = 0;
  targetPDU.byte(12) = 0;
  targetPDU.byte(13) = 0;
  targetPDU.byte(14) = 0;  
  targetPDU.byte(15) =0;
    
  frUpdatePDU(targetPDU, 1, -1);
}


  
  //TargetNetwork::AsdmFLC_FlexrayFr00 has been done
on frFrame TargetNetwork::AsdmFLC_FlexrayFr00
{
    if (receivedAsdmFLC_FlexraySignalIPdu00 == 1)
    {
        writeToLog("AsdmFLC_FlexrayFr00: %I64d\n", this.Time_ns);
        receivedAsdmFLC_FlexraySignalIPdu00 = 2;
    }
}

  //TargetNetwork::AsdmFLC_FlexrayFr01 has been done
on frFrame TargetNetwork::AsdmFLC_FlexrayFr01
{
    if (receivedAsdmFLC_FlexraySignalIPdu01 == 1)
    {
        writeToLog("AsdmFLC_FlexrayFr01: %I64d\n", this.Time_ns);
        receivedAsdmFLC_FlexraySignalIPdu01 = 2;  
      write("logfr01");
    }
}

 //TargetNetwork::AsdmFLC_FlexrayFr02 has been done
on frFrame TargetNetwork::AsdmFLC_FlexrayFr02
{
    if (receivedAsdmFLC_FlexraySignalIPdu02 == 1)
    {
        writeToLog("AsdmFLC_FlexrayFr02: %I64d\n", this.Time_ns);
        receivedAsdmFLC_FlexraySignalIPdu02 = 2;
      // write("logfr02");
    }
}

 //TargetNetwork::AsdmFLC_FlexrayFr03 has been done
on frFrame TargetNetwork::AsdmFLC_FlexrayFr03
{
    if (receivedAsdmFLC_FlexraySignalIPdu03 == 1)
    {
        writeToLog("AsdmFLC_FlexrayFr03: %I64d\n", this.Time_ns);
        receivedAsdmFLC_FlexraySignalIPdu03 = 2;
      // write("logfr03");
    }
}

 //TargetNetwork::AsdmFLC_FlexrayFr05 has been done

 //TargetNetwork::AsdmFlcFRNmPdu1 has been done
on frPDU  TargetNetwork::AsdmFlcFRNmPdu1
{
    if (receivedAsdmFlcFRNmPdu1 == 1)
    {
        writeToLog("AsdmFlcFRNmPdu1: %I64d\n", this.Time_ns);
        receivedAsdmFlcFRNmPdu1 = 2;
    }
}

//TargetNetwork::ASDMFlcFlexTimeSynchFr has been done
on frFrame TargetNetwork::ASDMFlcFlexTimeSynchFr
{
    if (receivedASDMFlcFlexTimeSynchPdu == 1)
    {
        writeToLog("ASDMFlcFlexTimeSynchFr: %I64d\n", this.Time_ns);
        receivedASDMFlcFlexTimeSynchPdu = 2;
    }
}

//on frPDU *
//{
//  if(has_logged_timesyn==0)
//  {
//   // setTimeSynchPdu ();
//    has_logged_timesyn =1;
//  }
//}

