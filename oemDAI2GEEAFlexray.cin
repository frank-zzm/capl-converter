/*@!Encoding:1252*/

variables
{
  byte firstTime = 1;
  byte firstLongitudinalSpeedReceived = 0;
  byte firstLongitudinalSpeedQualReceived = 0;
  byte firstYawRateReceived = 0;
  byte firstYawRateQualReceived = 0;
  byte firstLongAccelReceived = 0;
  byte firstLongAccelQualReceived = 0;
  byte firstFrontWheelAngReceieved = 0;
  byte firstFrontWheelAngQualReceieved = 0;
  byte firstTurnIndicatorReceived = 0;
  byte firstWheelSpeedFRreceived = 0;
  byte firstWheelSpeedFLreceived = 0;
  byte firstWheelSpeedRRreceived = 0;
  byte firstWheelSpeedRLreceived = 0;
  byte firstWheelSpeedQualReceived = 0;
  byte firstBrakeTorqueReceived = 0;
  
  byte receivedVehicleData = 0;
}

void UpdateOEMoutput(enum e_GwInternalVariables updatedSignal)
{
  switch (updatedSignal)
  {
    case eLongitudinalSpeed:
      SetLongitudinalSpeed();
      firstLongitudinalSpeedReceived = 1;
      break;

    case eLongitudinalSpeedQual:
      SetLongitudinalSpeedQual();
      firstLongitudinalSpeedQualReceived = 1;
      break;

    case eYawRate:
      SetYawRate();
      firstYawRateReceived = 1;
      break;

    case eYawRateQual:
      SetYawRateQual();
      firstYawRateQualReceived = 1;
      break;

    case eLongitudinalAcceleration:
      SetLongitudinalAcceleration();
      firstLongAccelReceived = 1;
      break;
      
    case eLongitudinalAccelerationQual:
      SetLongitudinalAccelerationQual();
      firstLongAccelQualReceived = 1;
      break;

    case eFrontWheelAngle:
      SetFrontWheelAngle();
      firstFrontWheelAngReceieved = 1;
      break;

    case eFrontWheelAngleQual:
      //SetFrontWheelAngleQual();
      firstFrontWheelAngQualReceieved = 1;
      break;

    case eTurnIndicator:
    //  SetTurnIndicator();
      firstTurnIndicatorReceived = 1;
      break;
    
    case eWheelSpeedFR:
      SetWheelSpeedFrontRight();
      firstWheelSpeedFRreceived = 1;
      break;
    
   case eWheelSpeedFL:
      SetWheelSpeedFrontLeft();
      firstWheelSpeedFLreceived = 1;
      break;
      
    case eWheelSpeedRR:
      SetWheelSpeedRearRight();
      firstWheelSpeedRRreceived = 1;
      break;
      
    case eWheelSpeedRL:
      SetWheelSpeedRearLeft();
      firstWheelSpeedRLreceived = 1;
      break;
      
    case eWheelSpeedQual:
     // SetWheelSpeedQual();
      firstWheelSpeedQualReceived = 1;
      break;

    case eBrakeTorque:
    //  SetBrakeTorque();
      firstBrakeTorqueReceived = 1;
      break;
    case eDrivingDirection:
     SetDrivingDirction();
     break;    
    default:
   //   writeToLog("ERROR: Unknown internal GW signal! Number = %d\n", updatedSignal);
      return;
  }

//  if (FirstValidVehicleDataReceived() == 1)
//  {
//    // "Unmute" channel after all signals of interest have been received
//    canSetChannelOutput(1, 1);
//  }
}

//byte FirstValidVehicleDataReceived()
//{
//  if (receivedVehicleData == 0 &&
//      firstLongitudinalSpeedReceived == 1 &&
//      firstLongitudinalSpeedQualReceived == 1 &&
//      firstYawRateReceived == 1 &&
//      firstYawRateQualReceived == 1 &&
//      firstLongAccelReceived == 1 &&
//      firstLongAccelQualReceived == 1 &&
//      firstFrontWheelAngReceieved == 1 &&
//      firstFrontWheelAngQualReceieved == 1 &&
//      firstTurnIndicatorReceived == 1 &&
//      firstWheelSpeedFRreceived == 1 &&
//      firstWheelSpeedFLreceived == 1 &&
//      firstWheelSpeedRRreceived == 1 &&
//      firstWheelSpeedRLreceived == 1 &&
//      firstWheelSpeedQualReceived == 1 &&
//      firstBrakeTorqueReceived == 1)
//  {
//    return 1;
//  }
//  return 0;
//}

void SetLongitudinalSpeed(void)
{
 // float ifvip_longitudinalSpeed=0.0;
//  ifvip_longitudinalSpeed= longitudinalSpeed;
  write("longitudinalSpeed is %f",longitudinalSpeed);
 SG_longitudinalSpeed=(int)(longitudinalSpeed * 0.01/0.00391);
}

void SetLongitudinalSpeedQual(void)
{
  //setting of signal longitudinalSpeedQual
  if(longitudinalSpeedQual == 2)
  {
    SG_longitudinalSpeedQual= 3;
  }
  else
  {
    SG_longitudinalSpeedQual= 0;
  }
}

void SetYawRate(void)
{
  //setting of signal YawRate
  //@sysvar::UserVariables::YawRate = __round(yawRate);
//  float ifvip_yawRate=0.0;
  //ifvip_yawRate= yawRate;
 //  write("ifvip_yawRate is %d",ifvip_yawRate);
  SG_yawRate=(int)(yawRate  / 10000 / 0.000244140625);
}

void SetYawRateQual(void)
{
  //setting of signal YawRateQual
  if(yawRateQual == 2)
  {
    SG_yawRateQual= 3;
  }
  else
  {
    SG_yawRateQual= 0;
  }
}
void SetDrivingDirction(void)
{
  if(drivingDirection==0)
  {SG_DrivingDirection=0;}
  if(drivingDirection==1)
  {SG_DrivingDirection=4;}
  if(drivingDirection==2)
  {SG_DrivingDirection=6;}
  if(drivingDirection==3)
  {SG_DrivingDirection=0;}
  write("the origin direction value is %d",drivingDirection);
}

void SetLongitudinalAcceleration(void)
{
  //float ifvip_longitudinalAcceleration=0.0;
 
 // ifvip_longitudinalAcceleration= longitudinalAcceleration;
 SG_longitudinalAcceleration=(int)(longitudinalAcceleration / 100 / 0.0085) ;
 // write("ifvip_longitudinalAcceleration is %d",longitudinalAcceleration);

}

void SetLongitudinalAccelerationQual(void)
{
  if (longitudinalAccelerationQual == 2) {
    SG_longitudinalAccelerationQual= 3;
  }
  else {
    SG_longitudinalAccelerationQual= 0;
  }
}

void SetFrontWheelAngle(void)
{
float ifvip_wheelangle=0.0;
//  ifvip_wheelangle= frontWheelAngle*0.0174533/0.0009765625;
//  write("ifvip_wheelangle is %d",ifvip_wheelangle);
  SG_frontWheelAngle=(int)frontWheelAngle * pi / 180;
  //write("frontWheelAngle is %d",(int)(frontWheelAngle/0.0009765625));
}

void SetFrontWheelAngleQual(void)
{
//  if (frontWheelAngleQual == 0 || frontWheelAngleQual == 1) {
//    setsignal(genericTargetNetwork::frontWheelAngleQual, 1);
//  }
//  else {
//    setsignal(genericTargetNetwork::frontWheelAngleQual, 0);
//  }
}

//void SetRearWheelAngle(void)
//{
//  setsignal(genericTargetNetwork::rearWheelAngle, rearWheelAngle * 1.0);
//}
//
//void SetRearWheelAngleQual(void)
//{
//  setsignal(genericTargetNetwork::rearWheelAngleQual, 1);
//}

void SetWheelSpeedFrontRight(void)
{
 // float ifvip_wheelSpeedFr=0.0;
  
//  ifvip_wheelSpeedFr= wheelSpeedFR;

  SG_wheelSpeedFrontRight=(int)wheelSpeedFR * pi / 30;

}

void SetWheelSpeedFrontLeft(void)
{
 // float ifvip_wheelSpeedFr=0.0;
 // ifvip_wheelSpeedFr=(int)(wheelSpeedFL/0.00391);
  SG_wheelSpeedFrontLeft=(int)(wheelSpeedFL * pi / 30);

}

void SetWheelSpeedRearRight(void)
{
//  float ifvip_wheelSpeedRR=0.0;
//  ifvip_wheelSpeedRR=wheelSpeedRR;
  SG_wheelSpeedRearRight=(int)(wheelSpeedRR * pi / 30) ;
}

void SetWheelSpeedRearLeft(void)
{
 //  float ifvip_wheelSpeedRL=0.0;
//  ifvip_wheelSpeedRL=wheelSpeedRL;
  SG_wheelSpeedRearLeft=(int)(wheelSpeedRL * pi / 30);
}

//void SetWheelSpeedQual(void)
//{
//  if (wheelSpeedQual == 2) {
//    setsignal(genericTargetNetwork::wheelSpeedQual, 1);
//  }
//  else {
//    setsignal(genericTargetNetwork::wheelSpeedQual, 0);
// }
//}

//void SetTurnIndicator(void)
//{
//  setsignal(genericTargetNetwork::turnIndicator, turnIndicator);
//}

void SetBrakeTorque(void)
{
  int ifvip_brakeTorquetostandstill=0;
  float vip_brakeTorque=0.0;
  vip_brakeTorque=brakeTorque;
  
  SG_actualBreakTorquetostandstill= ifvip_brakeTorquetostandstill;
}
